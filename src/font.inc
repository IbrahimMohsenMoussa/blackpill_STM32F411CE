; ====================================================================
; fonts.asm - Read-Only Font Tables
; @Description: Standard 5x7 ASCII Font (Characters 0x20 to 0x7E)
; ====================================================================

    AREA |.rodata|, DATA, READONLY, ALIGN=2
    EXPORT Font5x7

; ----------------------------------------------------------------------------
; Standard 5x7 ASCII Font Table
; Each character is exactly 5 bytes wide. 
; Mapped vertically (LSB at top, MSB at bottom).
; ----------------------------------------------------------------------------
Font5x7
    ; ASCII 0x20 to 0x2F (Space to /)
    DCB 0x00, 0x00, 0x00, 0x00, 0x00 ; 0x20 Space
    DCB 0x00, 0x00, 0x2f, 0x00, 0x00 ; 0x21 !
    DCB 0x00, 0x07, 0x00, 0x07, 0x00 ; 0x22 "
    DCB 0x14, 0x7f, 0x14, 0x7f, 0x14 ; 0x23 #
    DCB 0x24, 0x2a, 0x7f, 0x2a, 0x12 ; 0x24 $
    DCB 0x23, 0x13, 0x08, 0x64, 0x62 ; 0x25 %
    DCB 0x36, 0x49, 0x55, 0x22, 0x50 ; 0x26 &
    DCB 0x00, 0x05, 0x03, 0x00, 0x00 ; 0x27 '
    DCB 0x00, 0x1c, 0x22, 0x41, 0x00 ; 0x28 (
    DCB 0x00, 0x41, 0x22, 0x1c, 0x00 ; 0x29 )
    DCB 0x14, 0x08, 0x3E, 0x08, 0x14 ; 0x2A *
    DCB 0x08, 0x08, 0x3E, 0x08, 0x08 ; 0x2B +
    DCB 0x00, 0x00, 0x50, 0x30, 0x00 ; 0x2C ,
    DCB 0x08, 0x08, 0x08, 0x08, 0x08 ; 0x2D -
    DCB 0x00, 0x60, 0x60, 0x00, 0x00 ; 0x2E .
    DCB 0x20, 0x10, 0x08, 0x04, 0x02 ; 0x2F /

    ; ASCII 0x30 to 0x39 (Numbers 0-9)
    DCB 0x3E, 0x51, 0x49, 0x45, 0x3E ; 0x30 0
    DCB 0x00, 0x42, 0x7F, 0x40, 0x00 ; 0x31 1
    DCB 0x42, 0x61, 0x51, 0x49, 0x46 ; 0x32 2
    DCB 0x21, 0x41, 0x45, 0x4B, 0x31 ; 0x33 3
    DCB 0x18, 0x14, 0x12, 0x7F, 0x10 ; 0x34 4
    DCB 0x27, 0x45, 0x45, 0x45, 0x39 ; 0x35 5
    DCB 0x3C, 0x4A, 0x49, 0x49, 0x30 ; 0x36 6
    DCB 0x01, 0x71, 0x09, 0x05, 0x03 ; 0x37 7
    DCB 0x36, 0x49, 0x49, 0x49, 0x36 ; 0x38 8
    DCB 0x06, 0x49, 0x49, 0x29, 0x1E ; 0x39 9

    ; ASCII 0x3A to 0x40 (: to @)
    DCB 0x00, 0x36, 0x36, 0x00, 0x00 ; 0x3A :
    DCB 0x00, 0x56, 0x36, 0x00, 0x00 ; 0x3B ;
    DCB 0x08, 0x14, 0x22, 0x41, 0x00 ; 0x3C <
    DCB 0x14, 0x14, 0x14, 0x14, 0x14 ; 0x3D =
    DCB 0x00, 0x41, 0x22, 0x14, 0x08 ; 0x3E >
    DCB 0x02, 0x01, 0x51, 0x09, 0x06 ; 0x3F ?
    DCB 0x32, 0x49, 0x59, 0x51, 0x3E ; 0x40 @

    ; ASCII 0x41 to 0x5A (Uppercase A-Z)
    DCB 0x7E, 0x11, 0x11, 0x11, 0x7E ; 0x41 A
    DCB 0x7F, 0x49, 0x49, 0x49, 0x36 ; 0x42 B
    DCB 0x3E, 0x41, 0x41, 0x41, 0x22 ; 0x43 C
    DCB 0x7F, 0x41, 0x41, 0x22, 0x1C ; 0x44 D
    DCB 0x7F, 0x49, 0x49, 0x49, 0x41 ; 0x45 E
    DCB 0x7F, 0x09, 0x09, 0x09, 0x01 ; 0x46 F
    DCB 0x3E, 0x41, 0x49, 0x49, 0x7A ; 0x47 G
    DCB 0x7F, 0x08, 0x08, 0x08, 0x7F ; 0x48 H
    DCB 0x00, 0x41, 0x7F, 0x41, 0x00 ; 0x49 I
    DCB 0x20, 0x40, 0x41, 0x3F, 0x01 ; 0x4A J
    DCB 0x7F, 0x08, 0x14, 0x22, 0x41 ; 0x4B K
    DCB 0x7F, 0x40, 0x40, 0x40, 0x40 ; 0x4C L
    DCB 0x7F, 0x02, 0x0C, 0x02, 0x7F ; 0x4D M
    DCB 0x7F, 0x04, 0x08, 0x10, 0x7F ; 0x4E N
    DCB 0x3E, 0x41, 0x41, 0x41, 0x3E ; 0x4F O
    DCB 0x7F, 0x09, 0x09, 0x09, 0x06 ; 0x50 P
    DCB 0x3E, 0x41, 0x51, 0x21, 0x5E ; 0x51 Q
    DCB 0x7F, 0x09, 0x19, 0x29, 0x46 ; 0x52 R
    DCB 0x46, 0x49, 0x49, 0x49, 0x31 ; 0x53 S
    DCB 0x01, 0x01, 0x7F, 0x01, 0x01 ; 0x54 T
    DCB 0x3F, 0x40, 0x40, 0x40, 0x3F ; 0x55 U
    DCB 0x1F, 0x20, 0x40, 0x20, 0x1F ; 0x56 V
    DCB 0x3F, 0x40, 0x38, 0x40, 0x3F ; 0x57 W
    DCB 0x63, 0x14, 0x08, 0x14, 0x63 ; 0x58 X
    DCB 0x07, 0x08, 0x70, 0x08, 0x07 ; 0x59 Y
    DCB 0x61, 0x51, 0x49, 0x45, 0x43 ; 0x5A Z

    ; ASCII 0x5B to 0x60 ([ to `)
    DCB 0x00, 0x7F, 0x41, 0x41, 0x00 ; 0x5B [
    DCB 0x02, 0x04, 0x08, 0x10, 0x20 ; 0x5C '\'
    DCB 0x00, 0x41, 0x41, 0x7F, 0x00 ; 0x5D ]
    DCB 0x04, 0x02, 0x01, 0x02, 0x04 ; 0x5E ^
    DCB 0x40, 0x40, 0x40, 0x40, 0x40 ; 0x5F _
    DCB 0x00, 0x01, 0x02, 0x04, 0x00 ; 0x60 `

    ; ASCII 0x61 to 0x7A (Lowercase a-z)
    DCB 0x20, 0x54, 0x54, 0x54, 0x78 ; 0x61 a
    DCB 0x7F, 0x48, 0x44, 0x44, 0x38 ; 0x62 b
    DCB 0x38, 0x44, 0x44, 0x44, 0x20 ; 0x63 c
    DCB 0x38, 0x44, 0x44, 0x48, 0x7F ; 0x64 d
    DCB 0x38, 0x54, 0x54, 0x54, 0x18 ; 0x65 e
    DCB 0x08, 0x7E, 0x09, 0x01, 0x02 ; 0x66 f
    DCB 0x0C, 0x52, 0x52, 0x52, 0x3E ; 0x67 g
    DCB 0x7F, 0x08, 0x04, 0x04, 0x78 ; 0x68 h
    DCB 0x00, 0x44, 0x7D, 0x40, 0x00 ; 0x69 i
    DCB 0x20, 0x40, 0x44, 0x3D, 0x00 ; 0x6A j
    DCB 0x7F, 0x10, 0x28, 0x44, 0x00 ; 0x6B k
    DCB 0x00, 0x41, 0x7F, 0x40, 0x00 ; 0x6C l
    DCB 0x7C, 0x04, 0x18, 0x04, 0x78 ; 0x6D m
    DCB 0x7C, 0x08, 0x04, 0x04, 0x78 ; 0x6E n
    DCB 0x38, 0x44, 0x44, 0x44, 0x38 ; 0x6F o
    DCB 0x7C, 0x14, 0x14, 0x14, 0x08 ; 0x70 p
    DCB 0x08, 0x14, 0x14, 0x18, 0x7C ; 0x71 q
    DCB 0x7C, 0x08, 0x04, 0x04, 0x08 ; 0x72 r
    DCB 0x48, 0x54, 0x54, 0x54, 0x20 ; 0x73 s
    DCB 0x04, 0x3F, 0x44, 0x40, 0x20 ; 0x74 t
    DCB 0x3C, 0x40, 0x40, 0x20, 0x7C ; 0x75 u
    DCB 0x1C, 0x20, 0x40, 0x20, 0x1C ; 0x76 v
    DCB 0x3C, 0x40, 0x30, 0x40, 0x3C ; 0x77 w
    DCB 0x44, 0x28, 0x10, 0x28, 0x44 ; 0x78 x
    DCB 0x0C, 0x50, 0x50, 0x50, 0x3C ; 0x79 y
    DCB 0x44, 0x64, 0x54, 0x4C, 0x44 ; 0x7A z

    ; ASCII 0x7B to 0x7E ({ to ~)
    DCB 0x00, 0x08, 0x36, 0x41, 0x00 ; 0x7B {
    DCB 0x00, 0x00, 0x7F, 0x00, 0x00 ; 0x7C |
    DCB 0x00, 0x41, 0x36, 0x08, 0x00 ; 0x7D }
    DCB 0x10, 0x08, 0x08, 0x10, 0x08 ; 0x7E ~

    ALIGN
    END